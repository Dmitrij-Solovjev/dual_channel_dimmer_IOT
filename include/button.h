#ifndef button_h
#define button_h

#include <Arduino.h>
#include "task_manager.h"

enum delay_time
{
	repeat_delay_time = 25,	// Время ожидания для действия удержания (двойное нажатия и долгое)
	pause_time = 150,		
	long_time = 450

};

enum button_state
{
	unpressed_state,
	unknown_state,
	double_state,
	long_state
};

enum buttons_name {
	ok,
	cancel,
	up,
	down
};

enum button_position {
	on = 1,
	off = 0
};


//#define DEBUG_BUTTON
#ifdef DEBUG_BUTTON
#include <map>

std::map<buttons_name, const char *> buttons_name_str {
	std::pair{ok,		"ok"},
	std::pair{cancel,	"cancel"},
	std::pair{up,		"up"},
	std::pair{down,		"down"},
};
#endif


class Button {
public:
	// Переменная-индикатор опущенного состояния кнопки
	// (подтянуть ли кнопку к земле или к питанию)
	const button_position resting_position;

	// Норме контакта, к которому подключена кнопка
	uint32_t pin;
private:
	// Имя кнопки
	const buttons_name name;
	
	// Состояние кнопки, обозначабщее какой тип нажатия, включая промежуточные положения
	button_state state = unpressed_state;
	task_manager *tasks;

	// Аккумулирует данные о состоянии кнопки (нажата ли и как долго),
	// нужна для подавления дребезга контактов
	uint8_t contact_bounce_counter = 0;
	bool contact_bounce_started = false;
	

	// последнее состояние кнопки (была ли она нажата или отпущена)
	bool last_state_is_pressed = false;

	std::function<void()> execute_single, execute_double, execute_long;	 		// функция-обертка, внутри которой происходит выполнение пользовательских команд
	std::function<void()> static_single, static_double, static_long, on_click, on_click2;	// функция-обертка, внутри которой происходит выполнение обработки нажатий class Button

public:
	Button(const uint32_t button_pin, task_manager *_tasks, const buttons_name button_name, const button_position input_pullup = on):
		name(button_name), pin(button_pin), tasks(_tasks), resting_position(input_pullup) {	}

	// Первые 3 функции нужны для вызова this.Clarify_Status_Long() и this.Clarify_Status_Single().
	// 4 вызывает функцию обработки нажатия, обработки дребезга контакта
	// Последние 3 непосредственно вызывают функции управления
	void init(std::function<void()> _static_single, // Первые 3 функции нужны для вызова this.Clarify_Status_Long() и this.Clarify_Status_Single().
			  std::function<void()> _static_double,
			  std::function<void()> _static_long,
			  std::function<void()> _on_click,
			  std::function<void()> _on_click2,
			  std::function<void()> _execute_single,
			  std::function<void()> _execute_double,
			  std::function<void()> _execute_long)
	{
		static_single = _static_single;
		static_double = _static_double;
		static_long   = _static_long;

		on_click  = _on_click;
		on_click2 = _on_click2;
		


		execute_single = _execute_single;
		execute_double = _execute_double;
		execute_long   = _execute_long;
		
		if (resting_position == on){
			pinMode(pin, INPUT_PULLUP);
		} else {
			pinMode(pin, INPUT_PULLDOWN);
		}

		attachInterrupt(pin, on_click, CHANGE);
	}


	// Обработка нажатия, а именно: проверка дребезга для дальнейшего вызова Detect_Press_Type()
	void Detect_Press() {
		//опрос происходит 50 раз в секунду (то есть каждые 20 мс)
		if (contact_bounce_started == false)	// нажатие кнопки не началось
		{
			//tasks->add_task(&on_click2, millis()+50 );
			contact_bounce_started = true;
			Contact_Bounce_Checker();
		}
		//создается некая переменная (удобно использовать имя вывода к которому подключена кнопка)
	}

	void Contact_Bounce_Checker() {
		//Serial.println(digitalRead(pin));

		//if (last_state_is_pressed == false)
		if (digitalRead(pin) != (resting_position + last_state_is_pressed) % 2) // состояние кнопки изменилось 
		{
			contact_bounce_counter++;
			//Serial.println("HELLO!");

						
		} else {
			contact_bounce_counter = 0;
			contact_bounce_started = false;
			return;
		}


		//когда кнопка нажата, то к переменной добавляется единица, если не нажата, то ей присваивается ноль
		//когда значение переменной достигает 4 (то есть 4*20мс = 200 мс кнопка была нажата, а дребезг происходит меньшее время), то выполняем что нужно
		if (contact_bounce_counter >= 5){
			last_state_is_pressed = (digitalRead(pin) != resting_position);
			#ifdef DEBUG_BUTTON
				if (last_state_is_pressed){
					Serial.println("Кнопка была нажата");
//					Serial.print(digitalRead(pin));
//					Serial.print(" : ");
//					Serial.println(resting_position);
				} else {
					Serial.println("Кнопка была отпущена");
//					Serial.println("Кнопка была нажата");
				}
			#endif
			contact_bounce_started = false;
			contact_bounce_counter = 0;
			Detect_Press_Type();
			return;
		}


		//опрос происходит 50 раз в секунду (то есть каждые 20 мс)
		tasks->add_task(&on_click2, millis() + 10);
	}

	// Расспознавание к какому типу нажатия относится событие: одинарное нажатие, двойное или длительное
	void Detect_Press_Type() {
		//if (millis() - last_push_time < 50) {
		//	last_push_time = millis();
		//	return;	// дребезг
		//}
		
		#ifdef DEBUG_BUTTON
			Serial.print(buttons_name_str[name]);
			Serial.print("-->");
		#endif

		if (state == unpressed_state)
		{ 	// Поступило новое событие. Кнопка нажата первый раз (I)
			// Таймер проверки длинного удержания
			//########################################################################################
			tasks->add_task(&static_long, millis() + long_time);
			#ifdef DEBUG_BUTTON
				Serial.println("(I)");
			#endif
			state = unknown_state;
		} else {
			if (state == unknown_state)
			{ 	// Всего возможно 2 варианта: кнопка отпущена (II) и кнопка нажата в двойном нажатии (III)
				if (digitalRead(pin) == resting_position)
				{ 	// Случай (II).
					// Таймер проверки одинарного нажатия
					#ifdef DEBUG_BUTTON
						Serial.println("(II)");
					#endif
					tasks->add_task(&static_single, millis() + pause_time);
					// Неясно это одиночное или двойное нажатие.
				}
				else
				{ 	// Случай (III), зафиксированно двойное нажатие
					// Таймер двойного нажатия (повтора)
					#ifdef DEBUG_BUTTON
						Serial.println("(III)");
					#endif

					tasks->add_task(&static_double, millis() + repeat_delay_time);
				}
			}
			else if (state == double_state or state == long_state)
			{ // Изменился статус у кнопки -> событие закончилось. Случай (IV)
				#ifdef DEBUG_BUTTON
					Serial.println("(IV)");
				#endif

				if (state == long_state){
					execute_long();
				} else if (state == double_state) {
					execute_double();
				}

				state = unpressed_state;
			} else {
				// Где-то ошибка
				#ifdef DEBUG_BUTTON
					Serial.println("(V), ERROR");
				#endif
			}
		}
	}

	void Clarify_Status_Long() {
		#ifdef DEBUG_BUTTON
			Serial.print(buttons_name_str[name]);
			Serial.print("-->");
			Serial.print("Clarify_Status_Long");
		#endif
		if (digitalRead(pin) != resting_position && state == unknown_state)
		{
			// У нас долгое удержание, теперь понятно, выполняем команду
			state = long_state;
			execute_long();

			// Увеличиваем частоту опроса
			//tasks->add_task(&static_long, millis() + repeat_delay_time);

			#ifdef DEBUG_BUTTON
				Serial.println("--> OK");
			#endif

		}
	}

	// для длительного и двойного нажатия доступна кастомизация: пока кнопка зажата выполнять раз в delay_ms действие
	void Repeat(std::function<void()> to_execute, uint16_t delay_ms = repeat_delay_time) {
		#ifdef DEBUG_BUTTON
			Serial.println("ПОВТОР ДЕЙСТВИЯ");
		#endif

		if (state == long_state){
			to_execute();
			tasks->add_task(&execute_long, millis() + delay_ms);
		} else if (state == double_state) {
			to_execute();
			tasks->add_task(&execute_double, millis() + delay_ms);
		}
	}

	void Clarify_Status_Single()
	{
		#ifdef DEBUG_BUTTON
			Serial.print(buttons_name_str[name]);
			Serial.print("-->");
			Serial.print("Clarify_Status_Single");
		#endif

		if (digitalRead(pin) == resting_position and state == unknown_state)
		{
			// У нас одиночное короткое нажатие, теперь понятно, выполняем команду
			execute_single();
			state = unpressed_state;
			// Таймер остановлен, кнопка возвращена в исходное состояние.

			#ifdef DEBUG_BUTTON
				Serial.println("--> OK");
			#endif
		}
	}

	void Clarify_Status_Double() {
		#ifdef DEBUG_BUTTON
			Serial.print(buttons_name_str[name]);
			Serial.print("-->");
			Serial.print("Clarify_Status_Double");
		#endif

		if (digitalRead(pin) != resting_position and state == unknown_state) {
			// У нас двойное удержание, теперь понятно, выполняем команду
			state = double_state;
			execute_double();

			// Увеличиваем частоту опроса
			//tasks->add_task(&static_long, millis() + repeat_delay_time);

			#ifdef DEBUG_BUTTON
				Serial.println("--> OK");
			#endif

		}
	}
};

#endif





#if 0
%%%%%%%%%%%%%%%%%%%%%%%%%%%%%%%%%%%%%%%%%%%%%%%#(/#%%%%%%%%%%%%%%%%%%%%%%%%%%%%%%%%%%%%%%%%%%%#%%%%%
%%%%%%%%%%%%%%%%%%%%%%%%%%%%%%%%%%%%%%%%%%%%#*/%&&%*%%%%%%%%%%%%%%%%%%%%%%%%%%%%%%%%%%%#%#%%%%######
%%%%%%%%%%%%%%%%%%%%%%%%%%%%%%%%%%%%%%%%%#*/%&%#/**,.**###%%%%%%%%%%%%%%%%%%%%%%%%%#%%%#%####%##%###
%%%%%%%%%%%%%%%%%%%%%%%%%%%%%%%%%%%%%%%(*#&%(**,****.,**(##%%%##%%%%%%%%%%%%%%%%%%%%%%%%%%%#########
%%%%%%%%%%%%%%%%%%%%%%%%%%%%%%%%%%%%#*/%&(*,********,.*,*##%###%%%##%%%%%####%%%%%%##%%#%%######%###
%%%%%%%%%%%%%%%%%%%%%%%%%%%%%%%%%%#*%&#*,**,,********.,***(#######%%%%%%#%###%###%%######%%#########
%%%%%%%%%%##%%%%%%%%%%%%%%%%%%%%#*&&(*,*,************.,*,*##%%%%%%%%%%###%###############%%#########
%%%%%%%%%%%%%%%%%%%%%%%%%%%%%%(*&%/,,,*************,...,,*(%%%#%%%%%%######%%%%##%%%#####%%%%%%#####
%%%%%%%%%%%%%%%%%%%%%%%%%%%%//&#**,,***********,,.,*****,,/##%%#%%%#%%%#%%%%%%%%%%%%%%##%%%##%##%###
%%%%%%%%%%%%%%%%%%%%%%%%%#//%(,*,************,.,,*******,#&#*(#%%#%%#%%%%%%%%%#%%%%%%%%#############
%%%%%%%%%%%%%%%%%%%%%#%%//%(,*************,..,********,,(&&&&%(*(%%%%%%%%%%%%%%#%%%%%%%%########%###
%%%%%%%%%%%%%%%%%%%%%%/*&(*,,,,********,..,**,***,****,/%%&%&&&%/.(#%%#%#%%%%%%%%%%%%%%%%###########
%%%%%%%%%%%%%%%%%%%%(*&#,,***********,.,****,.. ..,**,*%&%&&#*/((((/,,#%%#%%%%%%%%%%%%%%%%##########
%%%%%%%%%%%%%%%%%#(*%%*,**********,..,**,*.,/(((((*.,/&&&/*/((((((((((/*/%%%%%#%%%%%%%###%##########
%%%%%%%%%%%%%%%%#,#%*****,******,.,******,,((((((((,((*/((((((((((((((((/*(%#%#%%%%%%%%#############
%%%%%%%%%%%%%%%/(%/,******,***,.,******,  .*((((//**((((((((((((((((((((((*(%#%%%%#%################
%%%%%%%%%%%%%(*&#*,********,..******,         ,*/((((((((((((((((((((((((((*(%%%%%##%###%###%#######
%%%%%%%%%%%%*#%**********,..*****,         .(@&*(((((((((((((((((((((((((((/,#%%%%##%##%############
%%%%%%%%%%(*&(,*,,*****,.,..,,,         ,/. ,&&*(((*,*((((((((((((((/*,,,,*/,#%%%%%%################
%%%%%%%%%*(%/*,,*****,.**,*(/.       *(,    ,&&**/&&&&&&&%%#(/**/(*(&&%##%&%/*%%%#%#################
%%%%%%%#*#%********,.,,,...       *(.      .%&%/&&%%&&&&&&&&&&&&&%%&&%((,(%&%(*%%%##%###############
%%%%%%%%/**,*****,.*,*(/.      ,(,        ,&&%**//#%&&%&&&&&&&&&&&&&&%(/&&%&%%.##%#%%###############
%%%%%%%%%%%##((###/...      .(*         .#&&/%&&&&&%&&&&%%%##(((##%%&%&&&&&&&(*%%%###%##%%%#####%###
%%%%%%%%%%%%%%%%%%#*      *(.         .%&(/%&%&&%(((%&%#((((((((((#%&%%&&&%&/*/*,,*(#%#%%####%%%##%#
%%#%%%%%%%%%%%%%%%%*    *,         .#%(#&&&&&*.///%&&&&%#((((((#%%&&&&%#(/..,,,*(%%&%%%#/**(##%%##%#
%##%%%%%%%%%%%%%%%%&&%,         .((#&&&&&&&%,,#&&&&&&&&&&&&&&&%&&&&&&&%%,............*#%&%%%%#(//(#%
%%%%%%%%%%%%%%%%%%%%%#.      ,/(%&&&&&&&&&&&%&&&&&&%&&&(.(&&%&%&&&&%&&&( ...............*#&%%%%%%%%(
%%%%%%%%%%%%%%%%%%%%%(     ,(&&&&&&&&%&%&%&&&&&&&&&&&#,  ,%&&&&&&&&&%&%...................,#&&%&%&%%
%%%%%%%%%%%%%%%%%%%%%*   *#(/&&&(,/*,%%#%%#%%&&&&&%(*    .%&&&&&&&&&&%, ....................#&&%%%%%
#%%%%%%%%%%%%%##%%%%%/ (%&%%%(,#,/&&&&(.,%&&&&&&(/&&,    *%&&&%%&&&&#/#. .....    .,**/(((((####((/*
(//(((((((((//((((((##########(*&&&&&%&&&&&&#,,/,      . (&&&&&&&&&/.,..,/#%&&&&%%%%%%%&&&%%(*,,**((
****,**,**,,,,,,,,,***********,,####%&%(//#%&&&&&&%(. ../&&%%&&&&(.*#&&&%(/********,..,*/(((((((((((
,,,,,,,,,,,,,,,,,,,,,,,,,,*,,,*,.,(##&&&&&&&&&&&&&&&&&&&%#/%&&%*.,,,,,,.,,*****,..,******,,*,***,***
,,,,,,,,,,,,,,,,,,,,,,,,,,,,,,,,,,,..*#%%%%&&&%%&%&%&&&&&&%(*,,***********,...,,,,,,,,,,,,,,,,,,,,,,
,,,,,,,,,,,,,,,,,,,,,,,,,,,,,,,,,,,,,,,,,,,..,,,*//,*///*.,*****************..,,,,,,,,,,,,,,,,,,,,,,
,,,,,,,,,,,,,,,,,,,,,,,,,,,,,,,,,,,,,,,,,..,*,*/(**(((*.*,*******************,.,,,,,,,,,,,,,,,,,,,,,
,,,,,,,,,,,,,,,,,,,,,,,,,,,,,,,,,,,,..*,.,****,,,,*//,,***********************..,,,,,,,,,,,,,,,,,,,,
,,,,,,,,,,,,,,,,,,,,,,,,,,,,,,,,,,.*(/,,,,,**,,***/(((/,,,*//*,*,,************,.,,,,,,,,,,,,,,,,,,,,
,,,,,,,,,,,,,,,,,,,,,,,,,,,,,,,,,.*(*,**,*((**((((,,*,,,*((((*,*,,*************..,,,,,,,,,,,,,,,,,,,
,,,,,,,,,,,,,,,,,,,,,,,,,,,,,,,. .,.**,,/((**(((/,*****,/((/,,*,,**************..,,,,,,,,,,,,,,,,,,,
,,,,,,,,,,,,,,,,,,,,,,,,,,,,. .**,,**,*((/,/(((/,*******,,****,,***************..,,,,,,,,,,,,,,,,,,,
,,,,,,,,,,,,,,,,,,,,,,,,. .,,*,,.***,,//*,/(((*,**************,,***************..,,,,,,,,,,,,,,,,,,,
,,,,,,,,,,,,,,,,,,,,,,,, .,**(**/(((((((((/((/*,,,****,,*****,,****************, ,,,,,,,,,,,,,,,,,,,
,,,,,,,,,,,,,,,,,,,,,...,..((,,,,,,*(((*(/*/*,,*/(/,*((/,,*,,*,****************,.,,,,,,,,,,,,,,,,,,,
,,,,,,,,,,,,,,,.... .,,,,.,/,****,*((/*/((((,****,,/(((/,**.**..,**************,.,,,,,,,,,,,,,,,,,,,
,,,,,,,.....,(%&&&&&&*.,,,..****,/(((*/((((*,******(((*,***,,.,..**************,.,,,,,,,,,,,,,,,,,,,
,,,,,,.*&&&&&&&&/%&&&@(   ,****,/(((*/((((/,*******,,,*****,.,,,..*************,.,,,,,,,,,,,,,,,,,,,
,,,,,,,,,.*,(&%/#&&&&%,  ,****,/(((/*(((((*,**************, ,,,,,.*************..,(/,,,,,,,,,,,,,,,,
(((#((((/*.#&&#/&&&&*., ,****,/(((/*(((((/,****,,****,***,(&(.,,,.,************,,,,,,,,,,,,,,,,,,,,,
,,,,,,,,,.(&&&#%&&/ ,..*****,*((((*/(((((*,***,/&&%%&&&&&&&&&%.,,,.************..,,,,,,,,,,,,,,,,,,,
,,,,,,,,.,(%%/&&%..*..*****,*((((/*((((((,******,..,%&&&%%%%&&(....,***********..,,,,,,,,,,,,,,,,,,,
,,,,,,,,..(%/&&(.,,..******,/((((*/(((((*,*******,,#&&&%((##%/.,**,,***********. ,,,*(###/,,,..,,,,,
,,,,,,,,,.*/&(.,,,..******,/((((/*((((((,,******,,%&&&%#(###,,,****,***********,/%%(*,.,,*#%##(##%%(
,,,,,,,,,,,,,,,,, .******,*(((((*/(((((/,******,*%&&(%&&&%*,**,****,***********,.,,,,,,,,,,,,,..,,,,
,,,,,,,,,,,,,,,,..*******,/((((/*((((((*,******,%&%*%&%/,,****,,***,,**********,..,,,,,,,,,,,//*.,,,
*****,,,***,,,, .******//*(((((*/((((((*,*****,#%*.,.,,*******,,***,,**********,..,,,,,,,*/#(*/#/.,,
************/*..****/#%&*/((((/*((((((/*/**********************,****,**********,.,**//((/*,,.,,,(#/,
//(/**//*****,,((#%&&&&%*(((((**(((((((/%#*********************,,***************..,,,,,,,,,,,,,,,,,*
%%%%%#####(//.,#&&&&&&&//(((((*/(((((((/&&%(*******************,,**************,.,,,,,,,,,,,,,,,,,,,
(#####(##(((*,///**/#&#,/((((/,(((((((//&&&&%(*******************(**************.,*,,,,,,,,,,,,,,,,,
(/(((((((((/,/(((((((((((((((/*(((((((*(&&&&&&&#/***************,#%#/********/%#.,**,***,***,,,,,,,,
////////////,*/((((((((((((((*/(((((((/(&&&&&&&&&&#(************,*%&&&%%###%&&&#.///////////********
///////////(///,,*/((((((((((*/((((((((/*/#%&&&&&&&&&&%%(///**//(%&(,///(#%%&&&(*%%###########(####(
///////////////////,,,*((((((*/((((((((((((//*,*/(#%&&&&&&&&&&&&&&&((&&&&&&&%(*,(#%#%%###%###%%#####
///////////////////((*.,...*/*/(((((((((((((((((/(((((//////****///*&&&%%##%&&&%,(###(###%##((/////(
////////////////////(/..,,,,,,,,...,/(((((((((((((((((((((((((((((//&&#/(/////(%%*,////(((//((((//(/
////////////////////(/,..,,,,,,,,,,,.. .*,,***///(((((((((((((((((*#&&&#(//(////#&/,////////////////
///////////////////*..,,,,,,,,,,,,,,,,..//////////////*,...........*#&&&&&%(///#%&&/,///////////////
///////////*..,*/*..,,,,,,,,,,,,,,,,..,*////////////////*. .,,,.......  .*/(#%&&&&&&/,//////////////
///////////.      ,,,,,,,,,,,,,,... *///////////////////*..,,,,,,,,,,,,. ,//////****/*//////////////
///////////.        .,,,,,,,,,..,..*////////////////////, .,,,,,,,,,,,,,,.,/////////////////////////
/////////////****,..    .,,,...,,.,/////////////////////(/. ..,,,,,,,,,,,,.,/(//////////////////////
//////////////////////////////(/((/(////////////////////(/..,,.,,,,,,,,,..   .*/////////////*,..,*//
/////////////////////////////////////////////////////////*,... .,,,..          .*///////////////////
///////////////////////////////////////////////////////////////****,,,,,****///,.,,,*///////////////
////////////////////////////////////////////////////////////////////////////////////////////////////
/////////////////////////////////////**,,,*/////////////////////////////////////////////////////////
#endif